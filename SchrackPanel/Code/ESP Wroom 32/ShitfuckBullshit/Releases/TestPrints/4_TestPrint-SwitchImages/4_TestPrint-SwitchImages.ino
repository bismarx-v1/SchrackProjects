#include "Driver.h"
//#include "Graphics.h"

/***************\
* TestFrames	*
\***************/
uint8_t TestFrameHewwoCol3[294] = {1, 0, 0, 0, 1, 0, 0, 0, 0, 0, 0, 0, 0,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 0, 0};
uint8_t TestFrameHelloColGrtd[294] = {1, 0, 0, 0, 1, 0, 0, 0, 0, 0, 0, 0, 1,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 0, 0};
uint8_t TestFrameBarcodeH[294] = {1, 0, 1, 0, 1, 0, 1, 0, 1, 0, 1, 0, 1,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 1, 0};
uint8_t TestFrameBarcodeHInv[294] = {0, 1, 0, 1, 0, 1, 0, 1, 0, 1, 0, 1, 0,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 0, 1};
uint8_t TestFrameBarcodeW[294] = {1, 1, 1, 1, 1, 1, 1, 1, 1, 1, 1, 1, 1,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 1, 1};
uint8_t TestFrameBarcodeWInv[294] = {0, 0, 0, 0, 0, 0, 0, 0, 0, 0, 0, 0, 0,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 0, 0};
uint8_t TestFrameCheckerboard[294] = {1, 0, 1, 0, 1, 0, 1, 0, 1, 0, 1, 0, 1,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 1, 0};
uint8_t TestFrameCheckerboardInv[294] = {0, 1, 0, 1, 0, 1, 0, 1, 0, 1, 0, 1, 0,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 0, 1};

uint8_t Frame[336];

/***********\
* Functions	*
\***********/

/*******\
* Main	*
\*******/

TaskHandle_t Task1;
TaskHandle_t Task2;

/***************\
* Core0 code	*	// <Graphics>
\***************/
void codeForTask1( void * parameter) {
	uint8_t Rep = 0;
	for(;;) {	// <Task1 loop>
		for(uint8_t y = 0; y <= 7-1; y++) {
			for(uint16_t x = 0; x <= 42-1; x++) {
				switch(Rep) {
					case 0:
						Frame[y*48+x] = TestFrameHewwoCol3[y*42+x];	// Place test frame here
						break;
					case 1:
						Frame[y*48+x] = TestFrameHelloColGrtd[y*42+x];	// Place test frame here
						break;
					case 2:
						Frame[y*48+x] = TestFrameBarcodeH[y*42+x];	// Place test frame here
						break;
					case 3:
						Frame[y*48+x] = TestFrameBarcodeHInv[y*42+x];	// Place test frame here
						break;
					case 4:
						Frame[y*48+x] = TestFrameBarcodeW[y*42+x];	// Place test frame here
						break;
					case 5:
						Frame[y*48+x] = TestFrameBarcodeWInv[y*42+x];	// Place test frame here
						break;
					case 6:
						Frame[y*48+x] = TestFrameCheckerboard[y*42+x];	// Place test frame here
						break;
					case 7:
						Frame[y*48+x] = TestFrameCheckerboardInv[y*42+x];	// Place test frame here
						break;
				}
			}
			
			for(uint16_t x = 0; x <= 6-1; x++) {
				Frame[y*48+x+42] = 0;	// Reds		// Reds perma disabled here
			}
		}
		
		Rep++;
		if(Rep>7) {
			Rep = 0;
		}
		
		vTaskDelay(4000);
	};			// </Task1 loop>
}
/***************\
* /Core0 code	*	// </Graphics>
\***************/

/***************\
* Core1 code	*	// <Driver>
\***************/
void codeForTask2( void * parameter) {
	Driver_Setup();
	for(;;) {	// <Task2 loop>
		Driver_PrintFrame(Frame);
		vTaskDelay(0.01);	// Delay between frames
	};			// </Task2 loop>
}
/***************\
* /Core1 code	*	// </Driver>
\***************/

void setup() {
	Serial.begin(115200);
	
	
	/*
	* Pin Task1 to core
	*/
	xTaskCreatePinnedToCore(
		codeForTask1,	/* Task func*/
		"Task_1",		/* Name*/
		8000,			/* Stack size*/
		NULL,			/* Parameter of the task*/
		1,				/* Priority*/
		&Task1,			/* Task handle*/
		0				/* Core*/
	);
	
	/*
	* Pin Task2 to core
	*/
	xTaskCreatePinnedToCore(
		codeForTask2,	/* Task func*/
		"Task_2",		/* Name*/
		8000,			/* Stack size*/
		NULL,			/* Parameter of the task*/
		1,				/* Priority*/
		&Task2,			/* Task handle*/
		1				/* Core*/
	);
}

void loop() {
	//Serial.printf("MainLoop: %i\n", xPortGetCoreID());
	delay(100);
}
